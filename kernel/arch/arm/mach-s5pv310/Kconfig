## kernel/arch/arm/mach-s5pv310/Kconfig
```kconfig
# arch/arm/mach-s5pv310/Kconfig
#
# Copyright (c) 2010 Samsung Electronics Co., Ltd.
#		http://www.samsung.com/
#
# Licensed under GPLv2

# Configuration options for the S5PV310

if ARCH_S5PV310

config CPU_S5PV310
	bool
	select PLAT_S5P
	select S3C_PL330_DMA
	select S5PV310_PM if PM
	help
	  Enable S5PV310 CPU support

config CPU_S5PV310_EVT1
	bool "S5PV310 EVT1"
	help
	  Enable S5PV310 EVT1 CPU support

choice
	depends on MACH_SMDKV310 || MACH_SMDKC210
	prompt "Select Used Board"
	default	BOARD_SMDKC210

config BOARD_ACHRO4210
	bool "ACHRO4210 Dev Board"
	help
		Board used ACHRO4210(Hardkernel) Dev Board

config BOARD_SMDKC210
	bool "SMDKC210 Dev Board"
	help
		Board used SMDKC210(Samsung) Dev Board

endchoice

choice
	depends on BOARD_ACHRO4210
	prompt "Set CPU Max Speed"
	default MAX_CPU_1000M
	
config MAX_CPU_1000M
	bool "1000Mhz"
	help
		Set Cpu Clock to 1000Mhz

config MAX_CPU_1200M
	bool "1200Mhz"
	help
		Set Cpu Clock to 1200Mhz

config MAX_CPU_1504M
	bool "1504Mhz"
	help
		Set Cpu Clock to 1504Mhz

endchoice

config USE_EXT_GIC
	bool "Use external GIC and interrupt combiner"
	depends on CPU_S5PV310_EVT1
	help
	  Use external GIC and interrupt combiner
	  instead of internal GIC and interrupt combiner.

config S5PV310_DEV_PD
	bool
	help
	  Compile in platform device definitions for Power Domain

config S5PV310_SETUP_I2C1
	bool
	help
	  Common setup code for i2c bus 1.

config S5PV310_SETUP_FB_S3C
	bool
	default y
	help
	  Setup code for S5PV310 FIMD

config S5PV310_SETUP_FIMC0
	bool
	depends on VIDEO_FIMC
	default y
	help
	  Common setup code for FIMC controller 0.

config S5PV310_SETUP_FIMC1
	bool
	depends on VIDEO_FIMC
	default y
	help
	  Common setup code for FIMC controller 1.

config S5PV310_SETUP_FIMC2
	bool
	depends on VIDEO_FIMC
	default y
	help
	  Common setup code for FIMC controller 2.

config S5PV310_SETUP_FIMC3
	bool
	depends on VIDEO_FIMC
	default y
	help
	  Common setup code for FIMC controller 3.

config S5PV310_SETUP_CSIS
	bool
	depends on VIDEO_FIMC_MIPI
	default y
	help
	  Common setup code for MIPI-CSIS

config S5PV310_SETUP_I2C2
	bool
	help
	  Common setup code for i2c bus 2.

config S5PV310_SETUP_I2C3
	bool
	help
	  Common setup code for i2c bus 3.

config S5PV310_SETUP_I2C4
	bool
	help
	  Common setup code for i2c bus 4.

config S5PV310_SETUP_I2C5
	bool
	help
	  Common setup code for i2c bus 5.

config S5PV310_SETUP_I2C6
	bool
	help
	  Common setup code for i2c bus 6.

config S5PV310_SETUP_I2C7
	bool
	help
	  Common setup code for i2c bus 7.

config S5PV310_SETUP_SDHCI
	bool
	select S5PV310_SETUP_SDHCI_GPIO
	help
	  Internal helper functions for S5PV310 based SDHCI systems.

config S5PV310_SETUP_SDHCI_GPIO
	bool
	help
	  Common setup code for SDHCI gpio.

config S5PV310_SETUP_MSHCI
	bool
	select S5PV310_SETUP_MSHCI_GPIO
	help
	  Internal helper functions for S5PV310 based MSHCI systems.

config S5PV310_SETUP_MSHCI_GPIO
	bool
	help
	  Common setup code for MSHCI gpio.

config S5PV310_SETUP_USB_PHY
	bool
	depends on USB_SUPPORT
	default y
	help
	  Common setup code for USB PHY.

config S5PV310_PM
	bool
	help
	  Power Management code common to S5PV310

config SAMSUNG_IRQ_GPIO
	bool
	help
	  Internal configuration to build the IRQ GPIO demux code.

config S5PV310_DEV_PD
	bool
	help
	  Platform device definitions for S5PV310 power domain

config S5PV310_SETUP_TVOUT
	bool
	default y
	help
	Common setup code for TVOUT

config S5PV310_DEV_TS
        bool
        help
	    10.1inch size touchscreen for S5PV310

# machine support

config MACH_SMDKC210
	bool "SMDKC210"
	select CPU_S5PV310
	select ARCH_HAS_CPUFREQ
	select ARCH_SPARSEMEM_ENABLE
	select SAMSUNG_DEV_ADC
	select SAMSUNG_DEV_TS if !BOARD_ACHRO4210
	select S3C_DEV_WDT
	select HAVE_S3C2410_WATCHDOG
	select HAVE_PWM
	select S3C_DEV_I2C1
	select S3C_DEV_I2C2
	select S3C_DEV_I2C3 if !BOARD_ACHRO4210
	select S3C_DEV_I2C4 if !BOARD_ACHRO4210
	select S3C_DEV_I2C5 if !BOARD_ACHRO4210
	select S3C_DEV_I2C6 if !BOARD_ACHRO4210
	select S3C_DEV_I2C7 if !BOARD_ACHRO4210
	select S5PV310_SETUP_I2C1
	select S5PV310_SETUP_I2C2
	select S5PV310_SETUP_I2C3 if !BOARD_ACHRO4210
	select S5PV310_SETUP_I2C4 if !BOARD_ACHRO4210
	select S5PV310_SETUP_I2C5 if !BOARD_ACHRO4210
	select S5PV310_SETUP_I2C6 if !BOARD_ACHRO4210
	select S5PV310_SETUP_I2C7 if !BOARD_ACHRO4210
	select S3C_DEV_HSMMC if !S5P_DEV_MSHC
	select S3C_DEV_HSMMC2
	select S3C_DEV_HSMMC3 if !S5PV310_SD_CH2_8BIT
	select S5PV310_DEV_PD
	select S5PV310_SETUP_SDHCI
	select S5PV310_SETUP_MSHCI
	select S3C_DEV_RTC
	select S3C_DEV_GIB
	select S5PV310_DEV_PD if PM_RUNTIME
	help
	  Machine support for Samsung SMDKC210
	  S5PC210(MCP) is one of package option of S5PV310

config USE_GPIO_AS_I2C
	bool "Gpio_AS_i2c driver"
	depends on MACH_SMDKC210
	default n
	help
		Use GPIO pins as I2C
		This driver is misc devices  driver that uses xxx as minor number

config MACH_SMDKV310
	bool "SMDKV310"
	select CPU_S5PV310
	select ARCH_HAS_CPUFREQ
	select ARCH_SPARSEMEM_ENABLE
	select SAMSUNG_DEV_ADC
	select SAMSUNG_DEV_TS
	select S3C_DEV_WDT
	select HAVE_S3C2410_WATCHDOG
	select HAVE_PWM
	select S3C_DEV_I2C1
	select S3C_DEV_I2C2
	select S3C_DEV_I2C3
	select S3C_DEV_I2C4
	select S3C_DEV_I2C5
	select S3C_DEV_I2C6
	select S3C_DEV_I2C7
	select S5PV310_SETUP_I2C1
	select S5PV310_SETUP_I2C2
	select S5PV310_SETUP_I2C3
	select S5PV310_SETUP_I2C4
	select S5PV310_SETUP_I2C5
	select S5PV310_SETUP_I2C6
	select S5PV310_SETUP_I2C7
	select S3C_DEV_HSMMC if !S5P_DEV_MSHC
	select S3C_DEV_HSMMC2
	select S3C_DEV_HSMMC3 if !S5PV310_SD_CH2_8BIT
	select S5PV310_SETUP_SDHCI
	select S3C_DEV_RTC
	select S3C_DEV_GIB
	select S5PV310_DEV_PD if PM_RUNTIME
	help
	  Machine support for Samsung SMDKV310

comment "MMC/SD slot setup"
	depends on PLAT_S5P

menu "USE MSHC"
	config S5P_DEV_MSHC
	bool "MSHC"
	depends on PLAT_S5P
	default n
	help
		IF mshc(channel 4)  uses, channel 0 is disabled.

	config S5PV310_MSHC_CH0_NONREMOVABLE
	bool "Use Nonremovalble MMC at Channel 0"
	depends on S5P_DEV_MSHC
	default n
	help
		IF channel 0 is nonremovable MMC, select this option.
endmenu

menu "Use 8-bit bus width"
	config S5PV310_SD_CH0_8BIT
	bool "SDHC Channel 0"
	depends on PLAT_S5P && !S5P_DEV_MSHC
	default n
	help
		IF channel 0 uses 8-bit bus, channel 1 is disabled.

config S5PV310_SD_CH2_8BIT
	bool "SDHC Channel 2"
	depends on PLAT_S5P
	default n
	help
		IF channel 2 uses 8-bit bus, channel 3 is disabled.

config S5PV310_MSHC_CH0_8BIT
	bool "MSHC Channel 0"
	depends on PLAT_S5P && S5P_DEV_MSHC
	default n
	help
		IF channel 0 uses 8-bit bus, channel 1 is disabled.
endmenu

menu "Use DDR"
	depends on PLAT_S5P && S5P_DEV_MSHC && !S5PV310_MSHC_CH0_8BIT
config S5PV310_MSHC_CH0_DDR
	bool "Channel 0"
	default n
	help
		IF channel 0 is working with DDR(Dual Data Rate) mode, can't use 8-bit bus.
endmenu

choice
	prompt "Use Special PLL for MSHC"
	depends on PLAT_S5P && S5P_DEV_MSHC
	help
		This feature change MMC4OUT's clock source from MPLL to EPLL or VPLL
	default S5PV310_MSHC_EPLL_45MHZ if CPU_S5PV310_EVT1

config S5PV310_MSHC_MPLL_40MHZ
	bool "MPLL"

config S5PV310_MSHC_VPLL_46MHZ
	bool "VPLL"

config S5PV310_MSHC_EPLL_45MHZ
	bool "EPLL"
endchoice

menu "Use dynamic clock gating"
config MMC_CH0_CLOCK_GATING
	bool "Channel 0"
	depends on S3C_DEV_HSMMC
	default n
	help
		This feature turns off clock of channel 0
		for power saving when MMC/SD cards are not used.
config MMC_CH1_CLOCK_GATING
	bool "Channel 1"
	depends on S3C_DEV_HSMMC1
	default n
	help
		This feature turns off clock of channel 1
		for power saving when MMC/SD cards are not used.
config MMC_CH2_CLOCK_GATING
	bool "Channel 2"
	depends on S3C_DEV_HSMMC2
	default n
	help
		This feature turns off clock of channel 2
		for power saving when MMC/SD cards are not used.
config MMC_CH3_CLOCK_GATING
	bool "Channel 3"
	depends on S3C_DEV_HSMMC3
	default n
	help
		This feature turns off clock of channel 3
		for power saving when MMC/SD cards are not used.
config MMC_MSHC_CLOCK_GATING
	bool "MSHC"
	depends on S5P_DEV_MSHC
	default n
	help
		This feature turns off clock of MSHC
		for power saving when MMC/SD cards are not used.
endmenu

menu "Support dynamic cpu hotplug (Experimental)"
	depends on CPU_S5PV310 && HOTPLUG_CPU && SMP
	config S5PV310_PM_HOTPLUG
	bool "Dynamic hotplug"
	default n
	help
	  Support dynamic cpu hotplug to reduce power consumption
endmenu

config DEV_THERMAL
	bool "Enable TMU"
	select S5P_THERMAL
	help
		enable TMU
config S5P_THERMAL
	bool "Enable S5P_THERMAL"
	depends on DEV_THERMAL
	help
		enable TMU

config S5PV310_ASV
	bool "Enable ASV support"
	default n
	help
		Say Y here to enable ASV(Adaptive Supply Voltage)

menu "BUS Frequency and Voltage scaling (Experimental)"
	depends on CPU_S5PV310
	config S5PV310_BUSFREQ
	bool "BUS DVFS"
	default n
	help
	  Bus frequency and voltage scaling support.
endmenu

menu "CPUFreq step up sequence selection: 2 step or 3 step"
config FREQ_STEP_UP_L2_L0
	bool "Frequecy 2-step(default), 3-step(de-select)"
	default n
	help
	 This option makes to select frequecy step up sequence betweeen 2-step and 3-step.
	 2-step up as default raises to L2 level first, and L0 in seconde request.
	 ("Frequecy 2-step up: Other->L2->L0 for CPU Freq)
	 In case of 3-step up raises to L2, L1, and L0 level in order.
	 ("Frequecy 3-step up: Other->L2->L1->L0 for CPU Freq")
endmenu
endif
```

## kernel/drivers/gator/Kconfig
```kconfig
menuconfig ARM_STREAMLINE_DEBUGGER
	bool "Enable ARM Streamline Debugger"
	depends on  ARM 
	default n
	help
		Enable ARM Streamline debugger(DS-5).  

if ARM_STREAMLINE_DEBUGGER

config GATOR_MODULE_MAKE
	tristate "Make Gator driver for ARM Streamline debugger"
	default m
	select  PROFILING
	select  ENABLE_DEFAULT_TRACERS
	select  HIGH_RES_TIMERS
	select  LOCAL_TIMERS if SMP 
	help
		Make Gator driver enable for ARM Streamline debugger(DS-5).  

config GATOR_WITH_MALI_SUPPORT_T6XX
	bool "Debug with Mali-T6XX support"
	depends on  GATOR_MODULE_MAKE
	default n
	help
		Enable Mali Debug support.  

config GATOR_WITH_MALI_SUPPORT_400
	bool "Debug with Mali-400 support"
	depends on  GATOR_MODULE_MAKE
	default n
	help
		Enable Mali Debug support.  

endif
~               
```

## kernel/drivers/misc/mtv818/Kconfig
```kconfig
config TDMB_MTV818
    tristate "Raontech TDMB/FM module support(MTV350)"
    depends on SPI
    help
      This enables support for the RAONTECH TDMB module
```

## kernel/drivers/net/wireless/bcm4330_hk/Kconfig
```kconfig
config BCM4330_HK
	default n
	select WIRELESS_EXT
	select WEXT_PRIV
	tristate "HardKernel BCM4330(Broadcom) WiFi Driver"
	---help---
		Select this option to build Broadcom wlan driver
#config BCM_EMBED_FW
#	default n
#	bool "Broadcom Embed FW into WiFi Driver"
#	depends on BROADCOM_WIFI != n
#	---help---
#		Select this option to embed firmware into wlan driver
```
